## package/inetutils/Config.in
```kconfig
config BR2_PACKAGE_INETUTILS
	bool "inetutils"
	help
	  Inetutils is a collection of common network programs.

	  https://www.gnu.org/software/inetutils/
```

## package/openssh/Config.in
```kconfig
config BR2_PACKAGE_OPENSSH
	bool "openssh"
	depends on BR2_USE_MMU # fork()
	select BR2_PACKAGE_OPENSSL
	select BR2_PACKAGE_ZLIB
	help
	  A free version of the SSH protocol suite of network
	  connectivity tools. The standard 'ssh', 'sshd', 'scp', and
	  friends.

	  http://www.openssh.com/

if BR2_PACKAGE_OPENSSH

config BR2_PACKAGE_OPENSSH_UNSAFE_CONF
	bool "Use a unsafe configure file for test"
	help
	  Use a sshd_config that can login in root with password.

if !BR2_PACKAGE_OPENSSH_UNSAFE_CONF
menu "Custom configuration file"
config BR2_PACKAGE_OPENSSH_LISTEN_PORT
	string "listen port"
	default "22"

config BR2_PACKAGE_OPENSSH_LISTEN_ADDRESS
	string "listen address"
	default "0.0.0.0"

config BR2_PACKAGE_OPENSSH_LOGIN_GRACE_TIME
	string "login grace time"
	default "2m"

config BR2_PACKAGE_OPENSSH_PERMIT_ROOT_LOGIN
	string "whether root can log in"
	default "prohibit-password"

config BR2_PACKAGE_OPENSSH_PASSWORD_AUTH
	string "Specifies whether password authentication is allowed"
	default "yes"

config BR2_PACKAGE_OPENSSH_SESSION_MAINTENANCE_TIME
	string "Session maintenance time in seconds"
	default "0"

config BR2_PACKAGE_OPENSSH_MAX_AUTH_TRIES
	string "max auth tries"
	default "6"

config BR2_PACKAGE_OPENSSH_MAX_SESSIONS
	string "max sessions"
	default "10"

config BR2_PACKAGE_OPENSSH_DENY_USERS
	string "user names that refused to login"
	default ""

config BR2_PACKAGE_OPENSSH_ALLOW_USERS
	string "user names that allowed to login"
	default ""

endmenu
endif

endif
```

## package/openvas-libraries/Config.in
```kconfig
config BR2_PACKAGE_OPENVAS_LIBRARIES
    select BR2_PACKAGE_LIBGLIB2
    select BR2_PACKAGE_LIBGPG_ERROR_ARCH_SUPPORTS
    select BR2_PACKAGE_LIBPCAP
    select BR2_PACKAGE_LIBSSH
    select BR2_PACKAGE_GNUTLS
	select BR2_PACKAGE_HIREDIS
    select BR2_PACKAGE_UTIL_LINUX
	bool "openvas-libraries"
	help
	  This is the libraries module for the Open Vulnerability Assessment System.
```

## package/snort/Config.in
```kconfig
config BR2_PACKAGE_SNORT
	bool "snort"
	help
	  Snort is an open source network intrusion detection and prevention system.
	  It is capable of performing real-time traffic analysis, alerting, blocking 
	  and packet logging on IP networks.
```

## package/wput/Config.in
```kconfig
config BR2_PACKAGE_WPUT
	bool "wput"
	help
	  Wput is a command-line ftp-client that looks like wget but 
	  instead of downloading, uploads files or whole directories to 
	  remote ftp-servers.

	  http://wput.sourceforge.net/
```

## toolchain/toolchain-native/Config.in
```kconfig
if BR2_TOOLCHAIN_NATIVE

config BR2_TOOLCHAIN_NATIVE_PREFIX
	string "Toolchain prefix"
	default "sw_64-linux-gnu"

config BR2_TOOLCHAIN_NATIVE_C_LIBRARY
	string "Native toolchain C library"
	default "glibc"

config BR2_TOOLCHAIN_NATIVE_GLIBC
	bool
	select BR2_TOOLCHAIN_USES_GLIBC if BR2_TOOLCHAIN_NATIVE_C_LIBRARY="glibc"

choice
	bool "Native toolchain gcc version"
	default BR2_TOOLCHAIN_NATIVE_GCC_5_3

config BR2_TOOLCHAIN_NATIVE_GCC_5_3
	bool "5.3.x"
	select BR2_TOOLCHAIN_GCC_AT_LEAST_5_3

endchoice

choice
	bool "Native toolchain kernel headers series"
	help
	  Set to the kernel headers version that were used to build
	  this external toolchain.

	  This is used to hide/show some packages that have strict
	  requirements on the version of kernel headers.

config BR2_TOOLCHAIN_NATIVE_HEADERS_4_4
	bool "4.4.x"
	select BR2_TOOLCHAIN_HEADERS_AT_LEAST_4_4

endchoice

config BR2_TOOLCHAIN_NATIVE_HAS_SSP
	bool "Toolchain has SSP support?"
	select BR2_TOOLCHAIN_HAS_SSP
	default y if BR2_TOOLCHAIN_NATIVE_C_LIBRARY=glibc
	help
	  Selection this option if your external toolchain has Stack
	  Smashing Protection support enabled. If you don't know,
	  leave the default value, Buildroot will tell you if it's
	  correct or not.

config BR2_TOOLCHAIN_NATIVE_INET_RPC
	bool "Toolchain has RPC support?"
	select BR2_TOOLCHAIN_HAS_NATIVE_RPC
	default y if BR2_TOOLCHAIN_NATIVE_C_LIBRARY=glibc
	help
	  Select this option if your external toolchain supports
	  RPC. If you don't know, leave the default value, Buildroot
	  will tell you if it's correct or not.

config BR2_TOOLCHAIN_NATIVE_CXX
	bool "Toolchain has C++ support?"
	select BR2_INSTALL_LIBSTDCPP
	default y if BR2_TOOLCHAIN_NATIVE_C_LIBRARY=glibc
	help
	  Select this option if your external toolchain has C++
	  support. If you don't know, leave the default value,
	  Buildroot will tell you if it's correct or not.

config BR2_TOOLCHAIN_NATIVE_EXTRA_LIBS
	string "Extra toolchain libraries to be copied to target"
	help
	  If your external toolchain provides extra libraries that
	  need to be copied to the target filesystem, enter them
	  here, separated by spaces.

config BR2_TOOLCHAIN_NATIVE_GDB_SERVER_COPY
	bool "Copy gdb server to the Target"
	depends on BR2_TOOLCHAIN_NATIVE
	help
	  Copy the gdbserver provided by the external toolchain to the
	  target.

endif # BR2_TOOLCHAIN_NATIVE
```
